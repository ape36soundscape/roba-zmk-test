## config/boards/shields/Kconfig
```kconfig
# roBa test shields
rsource "roba_test_left/Kconfig"
rsource "roba_test_right/Kconfig"
```

## west.yml
```yaml
manifest:
  remotes:
    - name: zmkfirmware
      url-base: https://github.com/zmkfirmware
  projects:
    - name: zmk
      remote: zmkfirmware
      revision: main
      import: app/west.yml
    - name: zmk-pmw3610-driver
      url: https://github.com/badjeff/zmk-pmw3610-driver
      revision: main
      path: modules/lib/zmk-pmw3610-driver
  self:
    path: config
```
