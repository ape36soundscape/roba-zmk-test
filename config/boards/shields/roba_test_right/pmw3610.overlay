/ { sensors { pmw3610: pmw3610@0 { status = "disabled"; compatible = "zmk,pmw3610"; label = "TRACKBALL"; irq-gpios = <&gpio0 7 GPIO_ACTIVE_LOW>; spi-bus = <&spi0>; spi-max-frequency = <2000000>; cs-gpios = <&gpio0 8 GPIO_ACTIVE_LOW>; }; }; };